## CMakeLists.txt
```
# SPDX-License-Identifier: Apache-2.0

cmake_minimum_required(VERSION 3.20.0)
find_package(Zephyr REQUIRED HINTS $ENV{ZEPHYR_BASE})
project(LedControl)

target_sources(app PRIVATE src/base.c)
target_sources(app PRIVATE src/gpio.c)
target_sources(app PRIVATE src/str.c)
target_sources(app PRIVATE src/leds.c)
target_sources(app PRIVATE src/adc.c)
target_sources(app PRIVATE src/filter.c)
target_sources(app PRIVATE src/control.c)
target_sources(app PRIVATE src/pwm.c)
target_sources(app PRIVATE src/buttons.c)
target_sources(app PRIVATE src/uart.c)
target_sources(app PRIVATE src/timer.c)
target_sources(app PRIVATE src/schedule.c)
target_sources(app PRIVATE src/main.c)
```

## prj.conf
```kconfig
CONFIG_PRINTK=y
CONFIG_HEAP_MEM_POOL_SIZE=1024
CONFIG_ASSERT=y
CONFIG_GPIO=y
CONFIG_TIMING_FUNCTIONS=y
CONFIG_USE_SEGGER_RTT=y
CONFIG_RTT_CONSOLE=n
CONFIG_ADC=y
CONFIG_ADC_ASYNC=y
CONFIG_UART_CONSOLE=y
CONFIG_PWM=y

CONFIG_USE_SEGGER_RTT=n
CONFIG_RTT_CONSOLE=n
CONFIG_UART_CONSOLE=y
CONFIG_CONSOLE_SUBSYS=y
CONFIG_CONSOLE_GETCHAR=y
CONFIG_CONSOLE_GETCHAR_BUFSIZE=64
CONFIG_CONSOLE_PUTCHAR_BUFSIZE=512

CONFIG_NEWLIB_LIBC=y
CONFIG_NEWLIB_LIBC_FLOAT_PRINTF=y
```

## nrf52840dk_nrf52840.overlay
```dts
&pwm0 {
	ch0-pin = < 0xd >;
};
```

## src/main.c
```c
#include "base.h"
#include "gpio.h"
#include "adc.h"
#include "filter.h"
#include "control.h"
#include "pwm.h"
#include "buttons.h"
#include "uart.h"
#include "timer.h"
#include "schedule.h"

#define PRINT_INIT 0			///< enable for thread initialisation prints
#define PRINT_LOOP 0			///< enable for thread loop prints
unsigned int lock_key;

#define PWM_PERIOD 100			///<< period for the PWM signal in microseconds

//#define SAMPLING_PERIOD (1000*2)			///< sampling period in miliseconds
//#define ACTUATING_PERIOD (1800*2)			///< actuating period in milisecods
//#define BUTTOING_PERIOD (400*3)			///< buttons check period in miliseconds
//#define TIMING_PERIOD (3000*2)			///< timing period in miliseconds

#define SAMPLING_PERIOD (1000/5)			///< sampling period in miliseconds
#define ACTUATING_PERIOD (1800/9)			///< actuating period in milisecods
#define BUTTOING_PERIOD (400/4)			///< buttons check period in miliseconds
#define TIMING_PERIOD (3000/3)			///< timing period in miliseconds

#define MIN_PER_PERIOD 1			///< minutes to be counted per period
#define INITIAL_STATE 1				///< state machine initial state

#define KP 0.16				///< controller proportional coeficient
#define KI 0.06				///< controller intergral coeficient

//////////////////////////////////////////////////////////////////////////////////////////////////////////////////////////////////////////////

//#define CONFIG_NUM_PREEMPT_PRIORITIES 6
#define SAMPLING_PRIO 2			///< sampling thread priority
#define FILTERING_PRIO 2		///< filtering thread priority
#define CONTROLLING_PRIO 4		///< controlling thread priority
#define ACTUATING_PRIO 4		///< actuating thread priority
#define BUTTONING_PRIO 3		///< buttoing thread priority
#define MACHINING_PRIO 3		///< machining thread priority
#define UARTING_PRIO 3			///< uarting thread priority
#define TIMING_PRIO 1			///< timing thread priority
#define SCHEDULING_PRIO 5		///< scheduling thread priority

#define STACK_SIZE 1024							///< thread stack size
K_THREAD_STACK_DEFINE(sampling_stack,STACK_SIZE);		///< sampling thread stack size
K_THREAD_STACK_DEFINE(filtering_stack,STACK_SIZE);		///< filtering thread stack size
K_THREAD_STACK_DEFINE(controlling_stack,STACK_SIZE);		///< controlling thread stack size
K_THREAD_STACK_DEFINE(actuating_stack,STACK_SIZE);		///< actuating thread stack size
K_THREAD_STACK_DEFINE(buttoing_stack,STACK_SIZE);		///< buttoing thread stack size
K_THREAD_STACK_DEFINE(machining_stack,STACK_SIZE);		///< machining thread stack size
K_THREAD_STACK_DEFINE(uarting_stack,STACK_SIZE);		///< uarting thread stack size
K_THREAD_STACK_DEFINE(timing_stack,STACK_SIZE);			///< timing thread stack size
K_THREAD_STACK_DEFINE(scheduling_stack,STACK_SIZE);		///< scheduling thread stack size

struct k_thread sampling_data;	///< sampling thread initialisation
k_tid_t sampling_tid;			///< sampling thread initialisation
struct k_thread filtering_data;	///< filtering thread initialisation
k_tid_t filtering_tid;			///< filtering thread initialisation
struct k_thread controlling_data;	///< controlling thread initialisation
k_tid_t controlling_tid;		///< controlling thread initialisation
struct k_thread actuating_data;	///< actuating thread initialisation
k_tid_t actuating_tid;			///< actuating thread initialisation
struct k_thread buttoing_data;	///< buttoing thread initialisation
k_tid_t buttoing_tid;			///< buttoing thread initialisation
struct k_thread machining_data;	///< machining thread initialisation
k_tid_t machining_tid;			///< machining thread initialisation
struct k_thread uarting_data;		///< uarting thread initialisation
k_tid_t uarting_tid;			///< uarting thread initialisation
struct k_thread timing_data;		///< timing thread initialisation
k_tid_t timing_tid;			///< timing thread initialisation
struct k_thread scheduling_data;	///< scheduling thread initialisation
k_tid_t scheduling_tid;			///< scheduling thread initialisation

struct k_sem sem_samp;			///< sampling finished semafore
struct k_sem sem_act;			///< actuating started semafore
struct k_sem sem_contr;			///< controlling finished semafore
struct k_sem sem_but;			///< buttoing finished semafore
struct k_sem sem_tim;			///< timing finished semafore
struct k_sem sem_lockedstate;		///< lockedstate semafore

uint16_t filt_in=0;			///< shared memory between sampling and filtering
uint8_t contr_in=0;			///< shared memory between filtering and controlling
uint8_t act_in=0;				///< shared memory between controlling and actuating
uint8_t button_flag=0;			///< shared memory between buttoing and machining
uint8_t state=INITIAL_STATE;		///< shared memory between machining and uarting
int8_t target=50;				///< shared memory between scheduling and controlling
int8_t target_mod=12;			///< shared memory between machining and controlling

void sampling(void* A,void* B,void* C)
{
	if(PRINT_INIT)
	printk("\tLaunched sampling thread\n");

	int64_t curr_time=k_uptime_get();
	int64_t end_time=k_uptime_get()+SAMPLING_PERIOD;
	while(1)
	{
		filt_in=adc_sample();					// sample
		if(PRINT_LOOP==1)
		printk("\nsampling: sampled %u\n",filt_in);

		k_sem_give(&sem_samp);					// wake up filtering
		if(PRINT_LOOP==1)
		printk("sampling: finished sampling\n");

		curr_time=k_uptime_get();				// sleep until next period
		if(curr_time<end_time)					// sleep until next period
		{								// sleep until next period
			k_msleep(end_time-curr_time);			// sleep until next period
		}								// sleep until next period
		end_time+=SAMPLING_PERIOD;				// sleep until next period
	}
}

void filtering(void* A,void* B,void* C)
{
	if(PRINT_INIT)
	printk("\tLaunched filtering thread\n");
	while(1)
	{
		if(PRINT_LOOP==1)
		printk("filtering: waiting for sampling to finish\n");
		k_sem_take(&sem_samp,K_FOREVER);							// sleep until sampling finishes
		if(PRINT_LOOP==1)
		printk("filtering: sampling finished\n");

		contr_in=filter(filt_in);								// filter
		if(PRINT_LOOP==2)
		{
			lock_key=irq_lock();
			printk("\t\t\t\t\t\t\t\t %u\t-> %u\n",filt_in,contr_in);
			irq_unlock(lock_key);
		}

		if(PRINT_LOOP==1)
		printk("filtering: filtered %u to %u\n",filt_in,contr_in);
	}
}

void controlling(void* A,void* B,void* C)
{
	if(PRINT_INIT)
	printk("\tLaunched controlling thread\n");

	while(1)
	{
		if(PRINT_LOOP==1)
		printk("\ncontrolling: waiting for actuating to started\n");
		k_sem_take(&sem_act,K_FOREVER);							// sleep until actuating starts
		if(PRINT_LOOP==1)
		printk("controlling: actuating has started\n");

		act_in=controller(contr_in,target+target_mod);						// control
		if(PRINT_LOOP==2)
		{
			lock_key=irq_lock();
			printk("\t\t\t\t\t\t\t\t\t\t\t\t %u\t-> %u\n",contr_in,act_in);
			irq_unlock(lock_key);
		}

		if(PRINT_LOOP==1)
		printk("controlling: controlled %u to %u attempting to get %u\n",contr_in,act_in,target);

		k_sem_give(&sem_contr);									// wake up actuating
		if(PRINT_LOOP==1)
		printk("controlling: finished controlling\n");
	}
}

void actuating(void* A,void* B,void* C)
{
	if(PRINT_INIT)
	printk("\tLaunched actuating thread\n");

	int64_t curr_time=k_uptime_get();
	int64_t end_time=k_uptime_get()+ACTUATING_PERIOD;
	while(1)
	{
		k_sem_give(&sem_act);									// wake up controlling
		if(PRINT_LOOP==1)
		printk("actuating: started actuating\n");

		if(PRINT_LOOP==1)
		printk("actuating: waiting for controlling to finish\n");
		k_sem_take(&sem_contr,K_FOREVER);							// sleep until controlling finishes
		if(PRINT_LOOP==1)
		printk("actuating: contrlling has finished\n");

		pwm_led_set(act_in);									// act

		if(PRINT_LOOP==1)
		printk("actuating: pwm has been set to %u %%\n",act_in);

		curr_time=k_uptime_get();				// sleep until next period
		if(curr_time<end_time)					// sleep until next period
		{								// sleep until next period
			k_msleep(end_time-curr_time);			// sleep until next period
		}								// sleep until next period
		end_time+=ACTUATING_PERIOD;				// sleep until next period
	}
}

void buttoing(void* A,void* B,void* C)
{
	if(PRINT_INIT)
	printk("\tLaunched buttoing thread\n");

	int64_t curr_time=k_uptime_get();
	int64_t end_time=k_uptime_get()+BUTTOING_PERIOD;
	while(1)
	{
		button_flag=read_buttons(4)*8+read_buttons(3)*4+read_buttons(2)*2+read_buttons(1)*1;		// read buttons

		if(PRINT_LOOP==1)
		printk("\nbuttoing: %u read from buttons\n",button_flag);

		k_sem_give(&sem_but);								// wake up machining
		if(PRINT_LOOP==1)
		printk("buttoing: finished buttoing\n");

		curr_time=k_uptime_get();				// sleep until next period
		if(curr_time<end_time)					// sleep until next period
		{								// sleep until next period
			k_msleep(end_time-curr_time);			// sleep until next period
		}								// sleep until next period
		end_time+=BUTTOING_PERIOD;				// sleep until next period
	}
}

void machining(void* A,void* B,void* C)	
{
	if(PRINT_INIT)
	printk("\tLaunched machining thread\n");

	while(state==1||state==2)
	{
		if(PRINT_LOOP==1)
		printk("machining: waiting for buttoing to finish\n");
		k_sem_take(&sem_but,K_FOREVER);						// sleep until buttoing finishes
		if(PRINT_LOOP==1)
		printk("machining: buttoing has finished\n");

		if(PRINT_LOOP==1)
		printk("machining: waiting for state to be unlocked\n");
		k_sem_take(&sem_lockedstate,K_FOREVER);
		if(PRINT_LOOP==1)
		printk("machining: state has been unlocked\n");

		if(PRINT_LOOP==1)
		printk("machining: entering state %u\n",state);
		switch(state)
		{
			case 1:							// start of state 1 (manual state)
				if(button_flag==4&&target+target_mod>MIN_LIGHT)		// state action
				{								// state action
					target_mod-=2;					// state action
					if(PRINT_LOOP==1)
					printk("machining: light decreased\n");
				}								// state action
				else if(button_flag==8&&target+target_mod<MAX_LIGHT)		// state action
				{								// state action
					target_mod+=2;					// state action
					if(PRINT_LOOP==1)
					printk("machining: light increased\n");
				}								// state action

				if(button_flag==2)					// next state condition
				{								// next state condition
					state=2;						// next state condition
					if(PRINT_LOOP==0)
					printk("Entering Automatic State\n");
				}								// next state condition
				break;						// end of state 1 (manual state)

			case 2:							// start of state 2 (automatic state)
				if(button_flag==1)					// next state condition
				{								// next state condition
					state=1;						// next state condition
					if(PRINT_LOOP==0)
					printk("Entering Manual State\n");
				}								// next state condition
				break;						// end of state 2 (automatic state)
		}
		if(PRINT_LOOP==2)
		{
			lock_key=irq_lock();
			printk("\t\t\t\t\t\t\t\t\t\t\t\t\t\t\t\t %u\t-> %u\n",button_flag,state);
			irq_unlock(lock_key);
		}

		if(PRINT_LOOP==1)
		printk("machining: exiting to state %u\n",state);

		k_sem_give(&sem_lockedstate);
		if(PRINT_LOOP==1)
		printk("machining: allowing state to be locked\n");
	}
	if(PRINT_LOOP==1)
	printk("machining: unknown state\n");
}

void uarting(void* A,void* B,void* C)
{
	if(PRINT_INIT)
	printk("\tLaunched uarting thread\n");

	while(1)
	{
		if(state==1)
		{
			if(PRINT_LOOP==1)
			printk("uarting: in state1 eco is disabled and uart is ignored\n");
			get_dummy();
		}
		else if(state==2)
		{
			if(PRINT_LOOP==1)
			printk("uarting: in state2 eco is enabled and a period is read\n");
			uart_eco(1);
			
			if(PRINT_LOOP==1)
			printk("uarting: waiting for state to be locked\n");
			k_sem_take(&sem_lockedstate,K_FOREVER);
			if(PRINT_LOOP==1)
			printk("uarting: state has been locked\n");
			
			if(PRINT_LOOP==2)
			lock_key=irq_lock();
			uart_eco(1);
			set_period();
			uart_eco(0);
			if(PRINT_LOOP==2)
			irq_unlock(lock_key);
			print_schedule();
			button_flag=0;				// ignore button readings

			k_sem_give(&sem_lockedstate);
			if(PRINT_LOOP==1)
			printk("uarting: allowing state to be unlocked\n");
			
			get_dummy();
		}
	}
}

void timing(void* A,void* B,void* C)
{
	if(PRINT_INIT)
	printk("\tLaunched timing thread\n");

	int64_t curr_time=k_uptime_get();
	int64_t end_time=k_uptime_get()+TIMING_PERIOD;
	while(1)
	{
		update_time(MIN_PER_PERIOD);				// advance current time
		if(PRINT_LOOP==2)
		{
			lock_key=irq_lock();
			printk("\t\t\t\t\t");
			print_time(read_time_curr());
			printk("\n");
			irq_unlock(lock_key);
		}

		if(PRINT_LOOP==1)
		printk("\ntiming: a minute has passed\n");
		if(PRINT_LOOP==1)
		printk("\n");
		k_sem_give(&sem_tim);
		if(PRINT_LOOP==1)
		printk("timing: finished timing\n");

		curr_time=k_uptime_get();				// sleep until next period
		if(curr_time<end_time)					// sleep until next period
		{								// sleep until next period
			k_msleep(end_time-curr_time);			// sleep until next period
		}								// sleep until next period
		end_time+=TIMING_PERIOD;				// sleep until next period
	}
}

void scheduling(void* A,void* B,void* C)
{
	if(PRINT_INIT)
	printk("\tLaunched scheduling thread\n");

	int8_t prev_target=0;
	while(1)
	{
		if(PRINT_LOOP==1)
		printk("scheduling: waiting for timing to finish\n");
		k_sem_take(&sem_tim,K_FOREVER);
		if(PRINT_LOOP==1)
		printk("scheduling: timing has finished\n");

		prev_target=target;
		target=check_light();
		if(prev_target!=target)
		{
			target_mod=0;
		}

		if(PRINT_LOOP==2)
		{
			lock_key=irq_lock();
			printk("\t\t\t\t\t\t\t\t\t\t\t\t\t\t\t\t\t\t\t\t (%i)\n",target+target_mod);
			irq_unlock(lock_key);
		}

		if(PRINT_LOOP==1)
		printk("scheduling: this period's light is %u\n",target);
	}
}

void main()
{
	printk("\n\n\nLed Controller \n");

	uart_eco(1);

	adc_init();
	filter_init();
	control_init(KI,KP);
	pwm_init(PWM_PERIOD);
	buttons_init_(15,'h');
	uart_init();
	timer_init();
	schedule_init();

	if(PRINT_LOOP==2)
	{
		printk("\n\n\n");
		printk("\t\t\t\t\t time\t\t\t samp\t-> filt\t\t\t contr\t-> act\t\t\t butt\t-> state\t\t\t target");
		printk("\n\n\n");
	}

	uart_eco(0);

	k_sem_init(&sem_samp,0,1);		// init sampling finished semafore
	k_sem_init(&sem_act,0,1);		// init actuating started semafore
	k_sem_init(&sem_contr,0,1);		// init controlling finished semafore
	k_sem_init(&sem_but,0,1);		// init buttoing finished semafore
	k_sem_init(&sem_tim,0,1);		// init timing finished semafore
	k_sem_init(&sem_lockedstate,1,1);	// init lockedtate semafore

	sampling_tid=k_thread_create(&sampling_data,sampling_stack,K_THREAD_STACK_SIZEOF(sampling_stack),			// create sampling thread
		sampling,NULL,NULL,NULL,SAMPLING_PRIO,0,K_NO_WAIT);										// create sampling thread

	filtering_tid=k_thread_create(&filtering_data,filtering_stack,K_THREAD_STACK_SIZEOF(filtering_stack),			// create filtering thread
		filtering,NULL,NULL,NULL,FILTERING_PRIO,0,K_NO_WAIT);										// create filtering thread

	controlling_tid=k_thread_create(&controlling_data,controlling_stack,K_THREAD_STACK_SIZEOF(controlling_stack),	// create actuating thread
		controlling,NULL,NULL,NULL,CONTROLLING_PRIO,0,K_NO_WAIT);									// create actuating thread

	actuating_tid=k_thread_create(&actuating_data,actuating_stack,K_THREAD_STACK_SIZEOF(actuating_stack),			// create actuating thread
		actuating,NULL,NULL,NULL,ACTUATING_PRIO,0,K_NO_WAIT);										// create actuating thread

	buttoing_tid=k_thread_create(&buttoing_data,buttoing_stack,K_THREAD_STACK_SIZEOF(buttoing_stack),			// create buttoing thread
		buttoing,NULL,NULL,NULL,BUTTONING_PRIO,0,K_NO_WAIT);										// create buttoing thread

	machining_tid=k_thread_create(&machining_data,machining_stack,K_THREAD_STACK_SIZEOF(machining_stack),			// create machining thread
		machining,NULL,NULL,NULL,MACHINING_PRIO,0,K_NO_WAIT);										// create machining thread
	
	uarting_tid=k_thread_create(&uarting_data,uarting_stack,K_THREAD_STACK_SIZEOF(uarting_stack),				// create uarting thread
		uarting,NULL,NULL,NULL,UARTING_PRIO,0,K_NO_WAIT);										// create uarting thread
	
	timing_tid=k_thread_create(&timing_data,timing_stack,K_THREAD_STACK_SIZEOF(timing_stack),					// create timing thread
		timing,NULL,NULL,NULL,TIMING_PRIO,0,K_NO_WAIT);											// create timing thread
	
	scheduling_tid=k_thread_create(&scheduling_data,scheduling_stack,K_THREAD_STACK_SIZEOF(scheduling_stack),		// create scheduling thread
		scheduling,NULL,NULL,NULL,SCHEDULING_PRIO,0,K_NO_WAIT);									// create scheduling thread
}
```

## src/adc.c
```c
#include "adc.h"

// Global Variables:
static const struct device *adc_dev = NULL;
static uint16_t adc_sample_buffer;

// ADC channel struct Configuration:
static struct adc_channel_cfg adc_conf = {
	.gain = ADC_GAIN,
	.reference = ADC_REFERENCE,
	.acquisition_time = ADC_ACQUISITION_TIME,
	.channel_id = ADC_CHANNEL_ID,
	.input_positive = ADC_CHANNEL_INPUT
};

void adc_init()
{
      int err=0;

      /* ADC setup: bind and initialize */
      adc_dev = device_get_binding(DT_LABEL(ADC_NID));
      if (!adc_dev) 
      {
	    printk("\tADC device_get_binding() failed\n");
      } 
	
	struct adc_channel_cfg* padc_conf=&adc_conf;
      err = adc_channel_setup(adc_dev,padc_conf);
      if (err) 
      {
	    printk("\tadc_channel_setup() failed with error code %d\n", err);
      }
      
      /* It is recommended to calibrate the SAADC at least once before use, and whenever the ambient temperature has changed by more than 10 °C */
      NRF_SAADC->TASKS_CALIBRATEOFFSET = 1;

	printk("\tInitialised ADC module\n");
}

/* Takes one sample */
uint16_t adc_sample()
{
	const struct adc_sequence sequence = {
		.channels=BIT(ADC_CHANNEL_ID),
		.buffer=&adc_sample_buffer,
		.buffer_size=sizeof(adc_sample_buffer),
		.resolution=ADC_RESOLUTION,
	};

	int ret = adc_read(adc_dev, &sequence);
	if (ret) {
            printk("\tadc_read() failed with code %d\n", ret);
	}

	if(adc_sample_buffer>ADC_MAX_VALUE)
	{
		adc_sample_buffer=ADC_MAX_VALUE;
	}
	else if(adc_sample_buffer<ADC_MIN_VALUE)
	{
		adc_sample_buffer=ADC_MIN_VALUE;
	}
	
	return adc_sample_buffer; 
}
```

## src/adc.h
```c
/**
* \file adc.h
* \brief Analog-Digital Converter module
*
* This module contains functions to implement an AD converter
*
* \author Filipe Loureiro & Miguel Silva
* \date 19/06/22
* \version 5.2
* \bug No bugs detected
*/

#ifndef _ADC_H
#define _ADC_H

#include "base.h"

#define ADC_MIN_VALUE 0		///< minimum value to be interpreted by the ADC
#define ADC_MAX_VALUE 1023	///< maximum value to be interpreted by the ADC

#define ADC_NID DT_NODELABEL(adc) 
#define ADC_RESOLUTION 10

// Parameters for adc Struct Configuration
#define ADC_GAIN ADC_GAIN_1_4
#define ADC_REFERENCE ADC_REF_VDD_1_4
#define ADC_ACQUISITION_TIME ADC_ACQ_TIME(ADC_ACQ_TIME_MICROSECONDS, 40)
#define ADC_CHANNEL_ID 1
#define ADC_CHANNEL_INPUT NRF_SAADC_INPUT_AIN1 

///////////////////////////////////////////////////////////////////////////////////////
//  Public Functions:

/**
* \brief ADC initialization function
*
* Initializes the ADC in order to use it 
*
* \bug No bugs detected
*/
void adc_init();


/**
* \brief ADC read function
*
* Read a sample from ADC previosly configurated and return it
*
* \return Return the read value from adc
* \bug No bugs detected
*/
uint16_t adc_sample();

#endif
```

## src/base.c
```c
#include "base.h"

//////////////////////////////////////////////////////////////////////////////////////////////////////////////////////////////////////////////
// Private Member Functions

//////////////////////////////////////////////////////////////////////////////////////////////////////////////////////////////////////////////
// Public Member Functions

float saturation(float value,float min,float max)
{
	if(value<min){value=min;}
	else if(value>max){value=max;}
	return value;
}
```

## src/base.h
```c
/**
* \file base.h
* \brief Base file
*
* This file contain the basic includes and macros for general purpose
*
* \author Filipe Loureiro & Miguel Silva
* \date 15/06/22
* \version 5.4
* \bug No bugs detected
*/

#ifndef _BASE_H
#define _BASE_H

#include <zephyr.h>
#include <device.h>
#include <devicetree.h>
#include <drivers/gpio.h>
#include <sys/printk.h>
#include <sys/__assert.h>
#include <string.h>
#include <timing/timing.h>
#include <stdio.h>
#include <stdlib.h>
#include <stdint.h>
#include <drivers/adc.h>
#include <hal/nrf_saadc.h>
#include <math.h>

#define INT_SIZE 6
#define FLOAT_SIZE 3

//////////////////////////////////////////////////////////////////////////////////////////////////////////////////////////////////////////////
// Private Member Functions

//////////////////////////////////////////////////////////////////////////////////////////////////////////////////////////////////////////////
// Public Member Functions

float saturation(float value,float min,float max);

#endif
```

## src/buttons.c
```c
#include "buttons.h"
#include "gpio.h"

static int buttons_pin[4]={BUTTON1,BUTTON2,BUTTON3,BUTTON4};                  // Buttons data with pins numbers             
static int buttons_pos[4]={1,2,4,8};                                          // Buttons data with corresponding position 

static struct gpio_callback but1_cb_data;                                     // Callback structure related to BUTTON 1
static struct gpio_callback but2_cb_data;                                     // Callback structure related to BUTTON 2
static struct gpio_callback but3_cb_data;                                     // Callback structure related to BUTTON 3
static struct gpio_callback but4_cb_data;                                     // Callback structure related to BUTTON 4

static int but1_flag = 0;						      // Callback variable, flag to signal a BUTTON 1 press
static int but2_flag = 0;						      // Callback variable, flag to signal a BUTTON 2 press 
static int but3_flag = 0;						      // Callback variable, flag to signal a BUTTON 3 press 
static int but4_flag = 0;						      // Callback variable, flag to signal a BUTTON 4 press 

static const struct device *gpio0_dev;

///////////////////////////////////////////////////////////////////////////////////////
//  Private Functions:
void reset_flag(uint8_t n)
{
	switch(n)
	{
		case 1:
			but1_flag=0;	
			break;
		case 2:
			but2_flag=0; 
			break;
		case 3:
			but3_flag=0; 
			break;
		case 4:
			but4_flag=0;
			break;
	}
}

///////////////////////////////////////////////////////////////////////////////////////
// Calback Functions:
void but1_cbfunction(const struct device *dev, struct gpio_callback *cb, uint32_t pins)
{
      reset_flag(1);
      but1_flag=1;										      // Update Flag   
      if(PRINT_BUTTONS_DEBUG)
      {
	    printk("Button 1 Pressed\n\r");       									      // Update Flag 
      }
} 

void but2_cbfunction(const struct device *dev, struct gpio_callback *cb, uint32_t pins)
{
      reset_flag(2);
      but2_flag=1;	
      if(PRINT_BUTTONS_DEBUG)
      {
	    printk("Button 2 Pressed\n\r");       									      // Update Flag 
      }
} 

void but3_cbfunction(const struct device *dev, struct gpio_callback *cb, uint32_t pins)
{
      reset_flag(3);
      but3_flag=1;	
      if(PRINT_BUTTONS_DEBUG)
      {
	    printk("Button 3 Pressed\n\r");       									      // Update Flag 
      } 
} 

void but4_cbfunction(const struct device *dev, struct gpio_callback *cb, uint32_t pins)
{
      reset_flag(4);
      but4_flag=1;	
      if(PRINT_BUTTONS_DEBUG)
      {
	    printk("Button 4 Pressed\n\r");       									      // Update Flag 
      }
} 


void buttons_callback_init(char n_buttons)
{
      if((n_buttons & 1) == 1)
      {
	    if(PRINT_BUTTONS_DEBUG)
	    {
		  printk("Button 1 Callback Initialisition\n\r");
	    }
	    gpio_init_callback(&but1_cb_data, but1_cbfunction, BIT(BUTTON1));
	    gpio_add_callback(gpio0_dev, &but1_cb_data);
      }
      if((n_buttons & 2) == 2)
      {
	    if(PRINT_BUTTONS_DEBUG)
	    {
		  printk("Button 2 Callback Initialisition\n\r");
	    }
	    gpio_init_callback(&but2_cb_data, but2_cbfunction, BIT(BUTTON2));
	    gpio_add_callback(gpio0_dev, &but2_cb_data);
      }
      if((n_buttons & 4) == 4)
      {
	    if(PRINT_BUTTONS_DEBUG)
	    {
		  printk("Button 3 Callback Initialisition\n\r");
	    }
	    gpio_init_callback(&but3_cb_data, but3_cbfunction, BIT(BUTTON3));
	    gpio_add_callback(gpio0_dev, &but3_cb_data);
      }
      if((n_buttons & 8) == 8)
      {
	    if(PRINT_BUTTONS_DEBUG)
	    {
		  printk("Button 4 Callback Initialisition\n\r");
	    }
	    gpio_init_callback(&but4_cb_data, but4_cbfunction, BIT(BUTTON4));
	    gpio_add_callback(gpio0_dev, &but4_cb_data);
      }
}

///////////////////////////////////////////////////////////////////////////////////////
//  Public Functions:
void buttons_init(char n_buttons)                                     // Initialize the board's buttons  
{
	gpio0_dev=gpio0_init();
      int i=0;
      int ret=0;

      for(i=0; i<4; i++)
      {
		if((n_buttons & buttons_pos[i]) == buttons_pos[i])
		{
			
			ret = gpio_pin_configure(gpio0_dev, buttons_pin[i], GPIO_INPUT | GPIO_PULL_UP);
			if (ret < 0) 
			{
				printk("Error %d: Failed to configure Button %d \n\r", ret, (i+1));
				i=5;
			}
		}
      }
}

void buttons_init_(char n_buttons, char c)
{
      buttons_init(n_buttons);
      int ret=0;
      int i=0;
    
      if((c=='H') || (c='h'))												// Rising edge interrupt configuration
      {
	    for(i=0; i<4; i++)
	    {
		  if((n_buttons & buttons_pos[i]) == buttons_pos[i])
		  {
			if(PRINT_BUTTONS_DEBUG)
			{	  
			      printk("%d\n\r",buttons_pos[i]);
			}
			ret=gpio_pin_interrupt_configure(gpio0_dev, buttons_pin[i], GPIO_INT_EDGE_TO_ACTIVE);		// Button rising edge interrupt configuration 
			if (ret < 0)											// In case of fail initialization and consequent error message
			{ 
			      printk("Error %d: failed to configure interrupt on BUTTON %d pin \n\r", ret, (i+1));
			      return;
			}
		  }
	    }
      }
      else if((c=='L') || (c='l'))											// Falling edge interrupt configuration
      {
	    for(i=0; i<4; i++)
	    {
		  if((n_buttons & buttons_pos[i]) == buttons_pos[i])
		  {
			if(PRINT_BUTTONS_DEBUG)
			{
			      printk("%d\n\r",buttons_pos[i]);
			}
			ret=gpio_pin_interrupt_configure(gpio0_dev, buttons_pin[i], GPIO_INT_EDGE_TO_INACTIVE);		// Button falling edge interrupt configuration 
			if (ret < 0)											// In case of fail initialization and consequent error message
			{ 
			      printk("Error %d: failed to configure interrupt on BUTTON %d pin \n\r", ret, (i+1));
			      return;
			}
		  }
	    }
      }
      else if((c=='B') || (c='b'))											// Rising and falling edge interrupt configuration
      {
	    for(i=0; i<4; i++)
	    {	  
		  if((n_buttons & buttons_pos[i]) == buttons_pos[i])
		  {
			if(PRINT_BUTTONS_DEBUG)
			{
			      printk("%d\n\r",buttons_pos[i]);
			}
			ret=gpio_pin_interrupt_configure(gpio0_dev, buttons_pin[i], GPIO_INT_EDGE_BOTH);              // Button rising and fallinf edge interrupt configuration 
			if (ret < 0)                                                                                  // In case of fail initialization and consequent error message
			{ 
			      printk("Error %d: failed to configure interrupt on BUTTON %d pin \n\r", ret, (i+1));
			      return;
			}
		  }
	    }
      }

      buttons_callback_init(n_buttons);
	printk("\tInitialised buttons module\n");
}

uint8_t read_buttons(uint8_t button)
{
      uint8_t aux_flag=0;
      switch (button)
      {
	    case 1:
		  aux_flag=but1_flag;
		  reset_flag(1);
		  break;
     
	    case 2:
		  aux_flag=but2_flag;
		  reset_flag(2);
		  break;
     
	    case 3:
		  aux_flag=but3_flag;
		  reset_flag(3);
		  break;
	    case 4:
		  aux_flag=but4_flag;
		  reset_flag(4);
		  break;
	    default:
		  printk("Wrong argument for read_buttons\n\r");
		  break;
      }
	return aux_flag;
}
```

## src/buttons.h
```c
/**
* \file buttons.h
* \brief Buttons functions
*
* This module implements the functions to initialize and use the built in board buttons
* \author Filipe Loureiro e Miguel Silva
* \date 18/06/22
* \version 5.3
* \bug No bugs found
*/

#ifndef _BUTTONS_H
#define _BUTTONS_H

#include "base.h"
#include "gpio.h"
	    
#define PRINT_BUTTONS_DEBUG 0				    // For debug prints				  

#define BUTTON1 11                                          // BUTTON1 pin number of GPIO_0
#define BUTTON2 12                                          // BUTTON2 pin number of GPIO_0
#define BUTTON3 24                                          // BUTTON3 pin number of GPIO_0
#define BUTTON4 25                                          // BUTTON4 pin number of GPIO_0

///////////////////////////////////////////////////////////////////////////////////////
// Private Functions:

//void reset_flag(uint8_t n);
//void buttons_callback_init(char n_buttons);

///////////////////////////////////////////////////////////////////////////////////////
// Public Functions:

/**
* \brief Built in Buttons initialization function without interrupts
*
* Initializes the board buttons by using a byte for these porpouse, button 1 match to byte=1, button 2 match to byte=2, ect
*
* \param [IN] char n_buttons        -> byte corresponding to the buttons to activate
* \bug No bugs detected
*/

void buttons_init(char n_buttons);


/**
* \brief Built in Buttons initialization function with interrupts
*
* Initializes the board buttons by using a byte for these porpouse, button 1 match to byte=1, button 2 match to byte=2, ect
*
* \param [IN] char n_buttons        -> byte corresponding to the buttons to activate
* \param [IN] char c                -> 'H' or 'h' to interrupt at rising edge
                                    -> 'L' or 'l' to interrupt at falling edge
                                    -> 'B' or 'b' to interrupt at both edges
* \bug No bugs detected
*/

void buttons_init_(char n_buttons, char c);

/**
* \brief Read Buttons Flags
*
* Return the current flag button state
*
* \param [IN] int button	    -> the button number for read the flag 
* \bug No bugs detected
*/
uint8_t read_buttons(uint8_t button);

#endif
```

## src/control.c
```c
#include "control.h"

static float control_kp;
static float control_ki;

static float prop_error;
static float int_error;

//////////////////////////////////////////////////////////////////////////////////////////////////////////////////////////////////////////////
// Public Member Functions

void control_init(float kp,float ki)
{
	control_kp=kp;
	control_ki=ki;

	printk("\tInitialised controller module\n");
}

float controller(float curr,float target)
{
	target=saturation(target,MIN_CONTROLLER_VALUE,MAX_CONTROLLER_VALUE);	// proporcional error
	curr=saturation(curr,MIN_CONTROLLER_VALUE,MAX_CONTROLLER_VALUE);		// proporcional error
	prop_error=target-curr;									// proporcional error

	int_error+=prop_error;									// integral error
	int_error=int_error*DECAY_FACTOR;							// integral error
	int_error=saturation(int_error,MIN_INT_ERROR,MAX_INT_ERROR);		// integral error

	float r=(control_kp*prop_error+control_ki*int_error);
	return saturation(r,MIN_CONTROLLER_VALUE,MAX_CONTROLLER_VALUE);
}
```

## src/control.h
```c
/**
* \file control.h
* \brief Controller module
*
* This module contains functions to implement the controller
*
* \author Filipe Loureiro & Miguel Silva
* \date 20/06/22
* \version 5.10
* \bug No bugs found
*/

#ifndef _CONTROL_H
#define _CONTROL_H

#include "base.h"
#include "math.h"

#define DECAY_FACTOR 0.999
#define MIN_INT_ERROR -6000
#define MAX_INT_ERROR 6000

#define MIN_CONTROLLER_VALUE 0
#define MAX_CONTROLLER_VALUE 100

//////////////////////////////////////////////////////////////////////////////////////////////////////////////////////////////////////
// Public Member Functions

void control_init(float kp,float ki);
float controller(float curr,float target);

#endif
```

## src/demo_adc.c
```c
 /*
 * Paulo Pedreiras, 2022/03
 * Simple ADC example - nRF52840DK_nRF52840 board
 * 
 * 
 * Periodically reads ADC input and prints the corresponding raw and voltage value in the console
 * 
 * Adapted from: 
 *            https://devzone.nordicsemi.com/f/nordic-q-a/80685/using-saadc-in-nrf-connect-sdk/334204#334204
 *            https://github.com/simon-iversen/sdk-nrf/blob/light_controller/samples/light_controller/src/main.c
 * 
 *
 *      HW info
 *          https://infocenter.nordicsemi.com/topic/struct_nrf52/struct/nrf52840.html
 *          Section: nRF52840 Product Specification -> Peripherals -> GPIO / GPIOTE and SAADC 
 *          Board specific HW info can be found in the nRF52840_DK_User_Guide_20201203. I/O pins available at pg 27
 *
 *      Peripheral libs
 *          https://developer.nordicsemi.com/nRF_Connect_SDK/doc/latest/zephyr/reference/peripherals/index.html
 *          ADC     
 *
 *      NOTE 1:     **** NEVER APPLY MORE THAN 3 V (VDD) or negative voltages to ANx ****
 *
 *      NOTE 2:     In this board analog inputs are AIN{1,2,4,5,6,7} (see nRF52840_DK_User_Guide_20201203, page 28)
 *                  Some of the examples found in the internet are set to AIN0 and so do not work. The PCB also has a label "A0", which refers to Arduino and induces in error. 
 *    
 *      NOTE 3:     must add "CONFIG_ADC=y" to prj.conf
 * 
 */

#include <zephyr.h>
#include <device.h>
#include <drivers/gpio.h>
#include <drivers/adc.h>
#include <string.h>


/*ADC definitions and includes*/
#include <hal/nrf_saadc.h>
#define ADC_NID DT_NODELABEL(adc) 
#define ADC_RESOLUTION 10
#define ADC_GAIN ADC_GAIN_1_4
#define ADC_REFERENCE ADC_REF_VDD_1_4
#define ADC_ACQUISITION_TIME ADC_ACQ_TIME(ADC_ACQ_TIME_MICROSECONDS, 40)
#define ADC_CHANNEL_ID 1  

/* This is the actual nRF ANx input to use. Note that a channel can be assigned to any ANx. In fact a channel can */
/*    be assigned to two ANx, when differential reading is set (one ANx for the positive signal and the other one for the negative signal) */  
/* Note also that the configuration of differnt channels is completely independent (gain, resolution, ref voltage, ...) */
#define ADC_CHANNEL_INPUT NRF_SAADC_INPUT_AIN1 

#define BUFFER_SIZE 1

/* Other defines */
#define TIMER_INTERVAL_MSEC 1000 /* Interval between ADC samples */

/* ADC channel configuration */
static const struct adc_channel_cfg my_channel_cfg = {
	.gain = ADC_GAIN,
	.reference = ADC_REFERENCE,
	.acquisition_time = ADC_ACQUISITION_TIME,
	.channel_id = ADC_CHANNEL_ID,
	.input_positive = ADC_CHANNEL_INPUT
};

/* Global vars */
struct k_timer my_timer;
const struct device *adc_dev = NULL;
static uint16_t adc_sample_buffer[BUFFER_SIZE];

/* Takes one sample */
static int adc_sample(void)
{
	int ret;
	const struct adc_sequence sequence = {
		.channels = BIT(ADC_CHANNEL_ID),
		.buffer = adc_sample_buffer,
		.buffer_size = sizeof(adc_sample_buffer),
		.resolution = ADC_RESOLUTION,
	};

	if (adc_dev == NULL) {
            printk("adc_sample(): error, must bind to adc first \n\r");
            return -1;
	}

	ret = adc_read(adc_dev, &sequence);
	if (ret) {
            printk("adc_read() failed with code %d\n", ret);
	}	

	return ret;
}


void main(void)
{
    int err=0;

    /* Welcome message */
    printk("\n\r Simple adc demo for  \n\r");
    printk(" Reads an analog input connected to AN%d and prints its raw and mV value \n\r", ADC_CHANNEL_ID);
    printk(" *** ASSURE THAT ANx IS BETWEEN [0...3V]\n\r");
         
    /* ADC setup: bind and initialize */
    adc_dev = device_get_binding(DT_LABEL(ADC_NID));
	if (!adc_dev) {
        printk("ADC device_get_binding() failed\n");
    } 
    err = adc_channel_setup(adc_dev, &my_channel_cfg);
    if (err) {
        printk("adc_channel_setup() failed with error code %d\n", err);
    }
    
    /* It is recommended to calibrate the SAADC at least once before use, and whenever the ambient temperature has changed by more than 10 °C */
    NRF_SAADC->TASKS_CALIBRATEOFFSET = 1;
    
    /* Main loop */
    while(true){
        /* Get one sample, checks for errors and prints the values */
        err=adc_sample();
        if(err) {
            printk("adc_sample() failed with error code %d\n\r",err);
        }
        else {
            if(adc_sample_buffer[0] > 1023) {
                printk("adc reading out of range\n\r");
            }
            else {
                /* ADC is set to use gain of 1/4 and reference VDD/4, so input range is 0...VDD (3 V), with 10 bit resolution */
                printk("adc reading: raw:%4u / %4u mV: \n\r",adc_sample_buffer[0],(uint16_t)(1000*adc_sample_buffer[0]*((float)3/1023)));
            }
        }

        /* Sleep a while ... */
        k_msleep(TIMER_INTERVAL_MSEC);
    }
}
```

## src/demo_periodic_thread_DigIO.c
```c
/*
 * Paulo Pedreiras, 2022/02
 * Zephyr: Simple thread and digital IO example
 * 
 * Reads a button and sets a led according to the button state
 *
 * Base documentation:
 *  Zephyr kernel: 
 *      https://developer.nordicsemi.com/nRF_Connect_SDK/doc/latest/zephyr/reference/kernel/index.html
 *      
 *  DeviceTree 
 *      Board DTS can be found in BUILD_DIR/zephyr/zephyr.dts
 *      https://developer.nordicsemi.com/nRF_Connect_SDK/doc/latest/zephyr/guides/dts/api-usage.html#dt-from-c  
 *
 *  HW info
 *      https://infocenter.nordicsemi.com/topic/struct_nrf52/struct/nrf52840.html
 *      Section: nRF52840 Product Specification -> Peripherals -> GPIO / GPIOTE
 * 
 *      Board specific HW info can be found in the nRF52840_DK_User_Guide_20201203. I/O pins available at pg 27
 * 
 * 
 */

#include <zephyr.h>
#include <device.h>
#include <devicetree.h>
#include <drivers/gpio.h>
#include <sys/printk.h>
#include <sys/__assert.h>
#include <string.h>
#include <timing/timing.h>
#include <stdio.h>


/* Size of stack area used by each thread (can be thread specific, if necessary)*/
#define STACK_SIZE 1024

/* Thread scheduling priority */
#define thread_A_prio 1

/* Therad periodicity (in ms)*/
#define thread_A_period 20


/* Create thread stack space */
K_THREAD_STACK_DEFINE(thread_A_stack, STACK_SIZE);
  
/* Create variables for thread data */
struct k_thread thread_A_data;

/* Create task IDs */
k_tid_t thread_A_tid;

/* Thread code prototypes */
void thread_A_code(void *argA, void *argB, void *argC);

/* Refer to dts file */
#define GPIO0_NID DT_NODELABEL(gpio0) 
#define BOARDLED1 0xd /* Pin at which LED is connected. Addressing is direct (i.e., pin number) */
#define BOARDBUT1 0xb /* Pin at which BUT1 is connected. Addressing is direct (i.e., pin number) */


/* Main function */
void main(void) {

    thread_A_tid = k_thread_create(&thread_A_data, thread_A_stack,
        K_THREAD_STACK_SIZEOF(thread_A_stack), thread_A_code,
        NULL, NULL, NULL, thread_A_prio, 0, K_NO_WAIT);


    return;

} 

/* Thread code implementation */
void thread_A_code(void *argA , void *argB, void *argC)
{
    /* Local vars */
    int64_t fin_time=0, release_time=0;     /* Timing variables to control task periodicity */
    const struct device *gpio0_dev;          /* Pointer to GPIO device structure */
    int ret=0;                              /* Generic return value variable */
    
    /* Task init code */
    printk("Thread A init (periodic)\n");

    /* Bind to GPIO 0 */
    gpio0_dev = device_get_binding(DT_LABEL(GPIO0_NID));
    if (gpio0_dev == NULL) {
        printk("Failed to bind to GPIO0\n\r");        
	return;
    }
    else {
        printk("Bind to GPIO0 successfull \n\r");        
    }
    
    /* Configure PIN */
    ret = gpio_pin_configure(gpio0_dev, BOARDLED1, GPIO_OUTPUT_ACTIVE);
    if (ret < 0) {
        printk("Failed to configure LED 1 \n\r");
	return;
    }
    ret = gpio_pin_configure(gpio0_dev, BOARDBUT1, GPIO_INPUT | GPIO_PULL_UP);
    if (ret < 0) {
        printk("Failed to configure BUT 1 \n\r");
	return;
    }
       
    /* Compute next release instant */
    release_time = k_uptime_get() + thread_A_period;

    /* Thread loop */
    while(1) {        
        
        printk("Thread A activated\n\r");  
        
        if(gpio_pin_get(gpio0_dev,BOARDBUT1))
            gpio_pin_set(gpio0_dev, BOARDLED1, 1);
        else
            gpio_pin_set(gpio0_dev, BOARDLED1, 0);
       
        /* Wait for next release instant */ 
        fin_time = k_uptime_get();
        if( fin_time < release_time) {
            k_msleep(release_time - fin_time);
            release_time += thread_A_period;

        }
    }

    /* Stop timing functions */
    timing_stop();
}
```

## src/demo_periodic_thread_IOInterrupt.c
```c
/*
 * Paulo Pedreiras, 2022/02
 * Zephyr: Simple thread and Digital Input Interrupt example
 * 
 *  Button 1 generates an interrupt that toggles a global var
 *  Periodic task updates LED status according to global var
 *  Also shows how a single callback can handle multiple gpio interrupts
 *
 * Base documentation:
 *  Zephyr kernel: 
 *      https://developer.nordicsemi.com/nRF_Connect_SDK/doc/latest/zephyr/reference/kernel/index.html
 *      
 *  DeviceTree 
 *      Board DTS can be found in BUILD_DIR/zephyr/zephyr.dts
 *      https://developer.nordicsemi.com/nRF_Connect_SDK/doc/latest/zephyr/guides/dts/api-usage.html#dt-from-c  
 *
 *      HW info
 *      https://infocenter.nordicsemi.com/topic/struct_nrf52/struct/nrf52840.html
 *      Section: nRF52840 Product Specification -> Peripherals -> GPIO / GPIOTE
 * 
 *      Board specific HW info can be found in the nRF52840_DK_User_Guide_20201203. I/O pins available at pg 27
 * 
 * 
 */

#include <zephyr.h>
#include <device.h>
#include <devicetree.h>
#include <drivers/gpio.h>
#include <sys/printk.h>
#include <sys/__assert.h>
#include <string.h>
#include <timing/timing.h>
#include <stdio.h>


/* Size of stack area used by each thread (can be thread specific, if necessary)*/
#define STACK_SIZE 1024

/* Thread scheduling priority */
#define thread_A_prio 1

/* Therad periodicity (in ms)*/
#define thread_A_period 20


/* Create thread stack space */
K_THREAD_STACK_DEFINE(thread_A_stack, STACK_SIZE);
  
/* Create variables for thread data */
struct k_thread thread_A_data;

/* Create task IDs */
k_tid_t thread_A_tid;

/* Thread code prototypes */
void thread_A_code(void *, void *, void *);


/* Refer to dts file */
#define GPIO0_NID DT_NODELABEL(gpio0) 
#define BOARDLED1 0xd /* Pin at which LED is connected. Addressing is direct (i.e., pin number) */
#define BOARDBUT1 11 /* Pin at which BUT1 is connected. Addressing is direct (i.e., pin number) */
#define BOARDBUT2 12 /* Pin at which BUT2 is connected. Addressing is direct (i.e., pin number) */
#define BOARDBUT3 24 /* Pin at which BUT3 is connected. Addressing is direct (i.e., pin number) */
#define BOARDBUT4 25 /* Pin at which BUT4 is connected. Addressing is direct (i.e., pin number) */

const struct device *gpio0_dev;          /* Pointer to GPIO device structure */

/* Int related declarations */
static struct gpio_callback but1_cb_data; /* Callback structure */

/* Callback function and variables*/
volatile int ledstat = 0; /* Led status variable. Updated by the callback function */


void but1press_cbfunction(const struct device *dev, struct gpio_callback *cb, uint32_t pins) {
    
    /* Test each button ...*/
    if(BIT(BOARDBUT1) & pins) {
        /* Update global var*/
        ledstat=!ledstat;
        printk("BUT1 pressed - Led will toggle! \n\r");
    }

    if(BIT(BOARDBUT2) & pins) {
        /* Update global var*/        
        printk("BUT2 pressed - Led shall not toggle!\n\r");
    }

    if(BIT(BOARDBUT3) & pins) {
        /* Update global var*/        
        printk("BUT3 pressed - Led shall not toggle!\n\r");
    }

    if(BIT(BOARDBUT4) & pins) {
        /* Update global var*/        
        printk("BUT4 pressed - Led shall not toggle!\n\r");
    }

}


/* Main function */
void main(void) {
    int ret;

    /* Welcome message */
    printk("\n\r Press BUT1 to toggle the led.\n\r");

    /* Firts lets set the HW */
    /* Bind to GPIO 0 */
    gpio0_dev = device_get_binding(DT_LABEL(GPIO0_NID));
    if (gpio0_dev == NULL) {
        printk("Failed to bind to GPIO0\n\r");        
	return;
    }
    else {
        printk("Bind to GPIO0 successfull \n\r");        
    }
    
    /* Configure PINS */
    ret = gpio_pin_configure(gpio0_dev, BOARDLED1, GPIO_OUTPUT_ACTIVE);
    if (ret < 0) {
        printk("Error %d: Failed to configure LED 1 \n\r", ret);
	return;
    }
    ret = gpio_pin_configure(gpio0_dev, BOARDBUT1, GPIO_INPUT | GPIO_PULL_UP);
    if (ret < 0) {
        printk("Error %d: Failed to configure BUT 1 \n\r", ret);
	return;
    }

    ret = gpio_pin_configure(gpio0_dev, BOARDBUT2, GPIO_INPUT | GPIO_PULL_UP);
    if (ret < 0) {
        printk("Error %d: Failed to configure BUT 2 \n\r", ret);
	return;
    }

    ret = gpio_pin_configure(gpio0_dev, BOARDBUT3, GPIO_INPUT | GPIO_PULL_UP);
    if (ret < 0) {
        printk("Error %d: Failed to configure BUT 3 \n\r", ret);
	return;
    }

    ret = gpio_pin_configure(gpio0_dev, BOARDBUT4, GPIO_INPUT | GPIO_PULL_UP);
    if (ret < 0) {
        printk("Error %d: Failed to configure BUT 4 \n\r", ret);
	return;
    }


    /* Set interrupt HW - which pin and event generate interrupt */
    ret = gpio_pin_interrupt_configure(gpio0_dev, BOARDBUT1, GPIO_INT_EDGE_TO_ACTIVE);
    if (ret != 0) {
	printk("Error %d: failed to configure interrupt on BUT1 pin \n\r", ret);
	return;
    }

    /* Set interrupt HW - which pin and event generate interrupt */
    ret = gpio_pin_interrupt_configure(gpio0_dev, BOARDBUT2, GPIO_INT_EDGE_TO_ACTIVE);
    if (ret != 0) {
	printk("Error %d: failed to configure interrupt on BUT2 pin \n\r", ret);
	return;
    }

    /* Set interrupt HW - which pin and event generate interrupt */
    ret = gpio_pin_interrupt_configure(gpio0_dev, BOARDBUT3, GPIO_INT_EDGE_TO_ACTIVE);
    if (ret != 0) {
	printk("Error %d: failed to configure interrupt on BUT3 pin \n\r", ret);
	return;
    }

    /* Set interrupt HW - which pin and event generate interrupt */
    ret = gpio_pin_interrupt_configure(gpio0_dev, BOARDBUT4, GPIO_INT_EDGE_TO_ACTIVE);
    if (ret != 0) {
	printk("Error %d: failed to configure interrupt on BUT4 pin \n\r", ret);
	return;
    }
    
    /* Set callback */
    gpio_init_callback(&but1_cb_data, but1press_cbfunction, BIT(BOARDBUT1)| BIT(BOARDBUT2)| BIT(BOARDBUT3) | BIT(BOARDBUT4));
    gpio_add_callback(gpio0_dev, &but1_cb_data);

    
    /* Then create the task */
    thread_A_tid = k_thread_create(&thread_A_data, thread_A_stack,
        K_THREAD_STACK_SIZEOF(thread_A_stack), thread_A_code,
        NULL, NULL, NULL, thread_A_prio, 0, K_NO_WAIT);


    return;

} 

/* Thread code implementation */
void thread_A_code(void *argA , void *argB, void *argC)
{
    /* Local vars */
    int64_t fin_time=0, release_time=0;     /* Timing variables to control task periodicity */    
    int ret=0;                              /* Generic return value variable */
    
    /* Task init code */
    printk("Thread A init (periodic)\n");

    /* Compute next release instant */
    release_time = k_uptime_get() + thread_A_period;

    /* Thread loop */
    while(1) {        
               
        if(ledstat)
            gpio_pin_set(gpio0_dev, BOARDLED1, 1);
        else
            gpio_pin_set(gpio0_dev, BOARDLED1, 0);
       
        /* Wait for next release instant */ 
        fin_time = k_uptime_get();
        if( fin_time < release_time) {
            k_msleep(release_time - fin_time);
            release_time += thread_A_period;

        }
    }

    /* Stop timing functions */
    timing_stop();
}
```
